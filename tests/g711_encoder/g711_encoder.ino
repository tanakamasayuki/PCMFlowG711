// Unit tests for G711Encoder.
//
// Sweep the full 16-bit signed PCM range with a fine step and verify
// each output byte against the bit-exact reference table generated by
// tests/tools/gen_test_audio.py for both variants.
//
// This test exercises only the codec math; no PCMFlow runtime pipeline
// is involved. Safe to run before PCMFlow itself is registered.

#include <PCMFlowG711.h>

#include "input/reference.h"

static int g_pass = 0;
static int g_total = 0;

#define EXPECT_TRUE(name, cond) do { \
    ++g_total; \
    if (cond) { ++g_pass; Serial.print("PASS "); Serial.println(name); } \
    else { Serial.print("FAIL "); Serial.print(name); Serial.println(" cond"); } \
} while (0)

#define EXPECT_EQ(name, expected, actual) do { \
    ++g_total; \
    const long _e = (long)(expected); \
    const long _a = (long)(actual); \
    if (_e == _a) { ++g_pass; Serial.print("PASS "); Serial.println(name); } \
    else { \
        Serial.print("FAIL "); Serial.print(name); \
        Serial.print(" expected="); Serial.print(_e); \
        Serial.print(" actual=");   Serial.println(_a); \
    } \
} while (0)

static void test_encode_sweep(G711Variant variant, const uint8_t *ref, const char *tag)
{
    G711Encoder enc;
    EXPECT_TRUE("begin", enc.begin({8000, 1, 16}, variant));
    EXPECT_EQ ("variant", (int)variant, (int)enc.variant());
    EXPECT_EQ ("rate",   8000, enc.format().sampleRate);
    EXPECT_EQ ("ch",     1,    enc.format().channels);
    EXPECT_EQ ("bits",   16,   enc.format().bitsPerSample);

    // Encode the entire reference PCM array in one call.
    static uint8_t out[kG711EncodeRefCount];
    const size_t got = enc.encode(kG711EncodeRefPcm,
                                  kG711EncodeRefCount,
                                  out,
                                  kG711EncodeRefCount);
    EXPECT_EQ ("count", (long)kG711EncodeRefCount, (long)got);

    int mismatches = 0;
    int first_bad = -1;
    long first_pcm = 0;
    int first_e = 0, first_a = 0;
    for (size_t i = 0; i < kG711EncodeRefCount; ++i) {
        if (out[i] != ref[i]) {
            ++mismatches;
            if (first_bad < 0) {
                first_bad = (int)i;
                first_pcm = (long)kG711EncodeRefPcm[i];
                first_e = ref[i];
                first_a = out[i];
            }
        }
    }
    ++g_total;
    if (mismatches == 0) {
        ++g_pass;
        Serial.print("PASS "); Serial.print(tag); Serial.println("/all-samples-bit-exact");
    } else {
        Serial.print("FAIL "); Serial.print(tag); Serial.print("/all-samples-bit-exact");
        Serial.print(" mismatches="); Serial.print(mismatches);
        Serial.print(" first_idx="); Serial.print(first_bad);
        Serial.print(" pcm="); Serial.print(first_pcm);
        Serial.print(" expected="); Serial.print(first_e);
        Serial.print(" actual=");   Serial.println(first_a);
    }
}

static void test_buffer_too_small()
{
    G711Encoder enc;
    enc.begin({8000, 1, 16}, G711Variant::MuLaw);
    int16_t pcm[4] = {0, 0, 0, 0};
    uint8_t out[2];
    EXPECT_EQ("too-small/zero-bytes", 0, (long)enc.encode(pcm, 4, out, 2));
    EXPECT_EQ("too-small/error", (int)G711Encoder::Error::BufferTooSmall, (int)enc.lastError());
}

static void test_invalid_format()
{
    G711Encoder enc;
    EXPECT_TRUE("bad-rate/rejected",     !enc.begin({16000, 1, 16}, G711Variant::MuLaw));
    EXPECT_TRUE("bad-channels/rejected", !enc.begin({8000, 2, 16}, G711Variant::MuLaw));
    EXPECT_TRUE("bad-bits/rejected",     !enc.begin({8000, 1, 8},  G711Variant::MuLaw));
}

void setup()
{
    Serial.begin(115200);
    delay(500);
    Serial.println("TEST start g711_encoder");

    test_encode_sweep(G711Variant::MuLaw, kG711EncodeRefMuLaw, "mu");
    test_encode_sweep(G711Variant::ALaw,  kG711EncodeRefALaw,  "a");
    test_buffer_too_small();
    test_invalid_format();

    Serial.print("TEST done ");
    Serial.print(g_pass);
    Serial.print("/");
    Serial.println(g_total);
}

void loop()
{
    delay(1);
}
