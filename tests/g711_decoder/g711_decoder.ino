// Unit tests for G711Decoder.
//
// For each variant (mu-law / A-law), feed all 256 possible input byte
// values through G711Decoder::decode() and verify the produced PCM
// matches the bit-exact reference table generated by
// tests/tools/gen_test_audio.py.
//
// This test exercises only the codec math; no PCMFlow runtime pipeline
// is involved (no setInputSource, no pump). It is therefore safe to
// run before PCMFlow itself is published to the library registry.

#include <PCMFlowG711.h>

#include "input/reference.h"

static int g_pass = 0;
static int g_total = 0;

#define EXPECT_TRUE(name, cond) do { \
    ++g_total; \
    if (cond) { ++g_pass; Serial.print("PASS "); Serial.println(name); } \
    else { Serial.print("FAIL "); Serial.print(name); Serial.println(" cond"); } \
} while (0)

#define EXPECT_EQ(name, expected, actual) do { \
    ++g_total; \
    const long _e = (long)(expected); \
    const long _a = (long)(actual); \
    if (_e == _a) { ++g_pass; Serial.print("PASS "); Serial.println(name); } \
    else { \
        Serial.print("FAIL "); Serial.print(name); \
        Serial.print(" expected="); Serial.print(_e); \
        Serial.print(" actual=");   Serial.println(_a); \
    } \
} while (0)

static void test_decode_table(G711Variant variant, const int16_t *ref, const char *tag)
{
    G711Decoder dec;
    EXPECT_TRUE("begin", dec.begin({8000, 1, 16}, variant));
    EXPECT_EQ ("variant", (int)variant, (int)dec.variant());
    EXPECT_EQ ("rate",   8000, dec.format().sampleRate);
    EXPECT_EQ ("ch",     1,    dec.format().channels);
    EXPECT_EQ ("bits",   16,   dec.format().bitsPerSample);

    // Feed all 256 bytes in one call; compare to the reference table.
    uint8_t bytes[256];
    for (int i = 0; i < 256; ++i) bytes[i] = (uint8_t)i;
    int16_t out[256];
    const size_t got = dec.decode(bytes, 256, out, 256);
    EXPECT_EQ ("count", 256, (long)got);

    int mismatches = 0;
    int first_bad = -1;
    int16_t first_e = 0, first_a = 0;
    for (int i = 0; i < 256; ++i) {
        if (out[i] != ref[i]) {
            ++mismatches;
            if (first_bad < 0) {
                first_bad = i;
                first_e = ref[i];
                first_a = out[i];
            }
        }
    }
    ++g_total;
    if (mismatches == 0) {
        ++g_pass;
        Serial.print("PASS "); Serial.print(tag); Serial.println("/all-256-bit-exact");
    } else {
        Serial.print("FAIL "); Serial.print(tag); Serial.print("/all-256-bit-exact");
        Serial.print(" mismatches="); Serial.print(mismatches);
        Serial.print(" first_idx="); Serial.print(first_bad);
        Serial.print(" expected=");  Serial.print(first_e);
        Serial.print(" actual=");    Serial.println(first_a);
    }
}

static void test_invalid_format()
{
    G711Decoder dec;
    EXPECT_TRUE("bad-rate/rejected",     !dec.begin({16000, 1, 16}, G711Variant::MuLaw));
    EXPECT_TRUE("bad-channels/rejected", !dec.begin({8000, 2, 16}, G711Variant::MuLaw));
    EXPECT_TRUE("bad-bits/rejected",     !dec.begin({8000, 1, 8},  G711Variant::MuLaw));
    EXPECT_TRUE("not-ready",             !dec.isReady());
}

void setup()
{
    Serial.begin(115200);
    delay(500);
    Serial.println("TEST start g711_decoder");

    test_decode_table(G711Variant::MuLaw, kG711MuLawDecodeRef, "mu");
    test_decode_table(G711Variant::ALaw,  kG711ALawDecodeRef,  "a");
    test_invalid_format();

    Serial.print("TEST done ");
    Serial.print(g_pass);
    Serial.print("/");
    Serial.println(g_total);
}

void loop()
{
    delay(1);
}
